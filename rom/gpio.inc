; General Purpose Input/Output

PORT_GPO = 3
PORT_GPI = 3

GPI_MASK_BIT0_UNUSED    = 0x01
GPI_MASK_BIT1_UNUSED    = 0x02
GPI_MASK_BIT2_UNUSED    = 0x04
GPI_MASK_BIT3_UNUSED    = 0x08
GPI_MASK_BIT4_UNUSED    = 0x10
GPI_MASK_BIT5_UNUSED    = 0x20
GPI_MASK_BIT6_RTS       = 0x40  ; Active low
GPI_MASK_BIT7_RX        = 0x80  ; High until start bit

GPI_BIT_RX = 7

GPO_MASK_BIT0_TX        = 0x01  ; Held high until start bit
GPO_MASK_BIT1_CTS       = 0x02  ; Active low
GPO_MASK_BIT2_UNUSED    = 0x04
GPO_MASK_BIT3_UNUSED    = 0x08
GPO_MASK_BIT4_UNUSED    = 0x10
GPO_MASK_BIT5_UNUSED    = 0x20
GPO_MASK_BIT6_UNUSED    = 0x40
GPO_MASK_BIT7_UNUSED    = 0x80

GPO_BIT_TX = 0

GPO_BIT0_TX_STOP_BIT    = 0x01
GPO_BIT0_TX_START_BIT   = 0
GPO_BIT1_CTS_DISABLED   = 0x02
GPO_BIT1_CTS_ENABLED    = 0

GPO_DEFAULT             = GPO_BIT1_CTS_DISABLED | GPO_BIT0_TX_STOP_BIT
